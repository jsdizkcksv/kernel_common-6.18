## drivers/staging/android/Kconfig
```kconfig
# SPDX-License-Identifier: GPL-2.0
config ASHMEM
	bool "Enable the Anonymous Shared Memory Subsystem"
	depends on SHMEM
	help
	  The ashmem subsystem is a new shared memory allocator, similar to
	  POSIX SHM but with different behavior and sporting a simpler
	  file-based API.

	  It is, in theory, a good memory allocator for low-memory devices,
	  because it can discard shared memory units when under memory pressure.

config ASHMEM_C
	def_bool ASHMEM && !RUST
	help
	  Build the C ashmem driver from android16-6.12 instead of the Rust
	  one, for kernels built without Rust support.
```
